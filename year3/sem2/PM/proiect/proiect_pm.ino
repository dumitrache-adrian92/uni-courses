#include <Wire.h>
#include <SPI.h>

#include <WiFiManager.h>
#include <WiFiClient.h>
#include <ESP8266WiFi.h>
#include <ESP8266HTTPClient.h>
#include <Arduino_JSON.h>

#include <Adafruit_ILI9341.h>
#include <Adafruit_GFX.h>

#include <SimpleDHT.h>

#include <DS3231.h>
#include <Arduino.h>
#include <Clock.h>
#include <pgmspace.h>


WiFiClient client;
String IP;

const String openWeatherMapAPIKey = "XXXXXXXXXXXXXXXXXXXX";
String city;
String countryCode;
String jsonBuffer;

float temp = 0.0;
String weatherDescription = "";

#define TFT_DC D1
#define TFT_CS D2

Adafruit_ILI9341 display = Adafruit_ILI9341(TFT_CS, TFT_DC);

// 'PM logo', 320x240px bitmap
const unsigned char pmLogo [] PROGMEM = {
	0x00, 0x00, 0x00, 0x00, 0x00, 0x00, 0x00, 0x00, 0x00, 0x00, 0x00, 0x00, 0x00, 0x00, 0x00, 0x00,
	0x00, 0x00, 0x00, 0x00, 0x00, 0x00, 0x00, 0x00, 0x00, 0x00, 0x00, 0x00, 0x00, 0x00, 0x00, 0x00,
	0x00, 0x00, 0x00, 0x00, 0x00, 0x00, 0x00, 0x00, 0x00, 0x00, 0x00, 0x00, 0x00, 0x00, 0x00, 0x00,
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	0x00, 0x00, 0x00, 0x00, 0x00, 0x00, 0x00, 0x00, 0x00, 0x00, 0x00, 0x00, 0x00, 0x00, 0x00, 0x00
};

#define BUTTON_PIN D4
unsigned long lastButtonInterrupt = millis();

#define DHT_PIN 12
SimpleDHT22 dht22(DHT_PIN);

DS3231 RTC;
bool h12, hPM;
bool century = false;
int year;
String month;
byte day;
byte hour;
byte minute;
byte dayOfTheWeekNumeric;
String dayOfTheWeek;

typedef enum {
  weather = 0,
  humidity = 1,
  clock_and_date = 2,
  max_state = 3
} displayState;

volatile displayState state = weather;
float temperatureVal = 0.0;
float humidityVal = 0.0;
displayState lastState = max_state;

unsigned long lastWeatherReset = 0;
unsigned long lastClockReset = 0;

void setup() {
  Wire.begin();
  Serial.begin(57600);

  // set up clock
  getClockInfo();
  DateTime currentMoment = RTClib::now();

  MyClock.SetClock(currentMoment.unixtime(), false);

  // display setup
  display.begin();
  display.fillScreen(ILI9341_BLACK);
  display.setRotation(1);
  display.drawBitmap(0, 0, pmLogo, 320, 240, 0x83F8); //ILI9341_WHITE);

  // setup WiFi connection
  WiFiManager wm;

  // reset settings - wipe stored credentials for testing
  // these are stored by the esp library
  // wm.resetSettings();

  // Automatically connect using saved credentials,
  // if connection fails, it starts an access point with the specified name ( "AutoConnectAP"),
  // if empty will auto generate SSID, if password is blank it will be anonymous AP (wm.autoConnect())
  // then goes into a blocking loop awaiting configuration and will return success result
  bool res;
  res = wm.autoConnect("SmartMirrorAP","password"); // password protected ap

  if(!res) {
    Serial.println("Failed to connect");
  }
  else {
    //if you get here you have connected to the WiFi
    Serial.println("Connected to WiFi!");
  }

  // button setup
  pinMode(BUTTON_PIN, INPUT_PULLUP);
  attachInterrupt(digitalPinToInterrupt(BUTTON_PIN), button_isr, FALLING);

  // get IP
  getIPInfo();
  // get location based on IP
  getLocationInfo();
  // get
  getWeatherInfo();

  // DHT setup
  delay(2000);
  dht22.read2(&temperatureVal, &humidityVal, NULL);

  display.fillScreen(ILI9341_BLACK);
}

void loop() {
  // update weather and humidity information every 10 minutes
  if (millis() - lastWeatherReset >= 600000) {
    lastWeatherReset = millis();

    getWeatherInfo();
    humidityVal = 0.0;

    if (state == weather || state == humidity)
      lastState = max_state;
  }

	// check if clock needs to be updated
  Clock::EEvent eEvent;
	eEvent = MyClock.CheckEvent();

  if (eEvent != Clock::eEventNone) {
		updateClock();

    if (state == clock_and_date)
      lastState = max_state;
	}

  // if we haven't already gotten a humidity reading, keep trying
  if (state == humidity && humidityVal - 0.00 <= 0.001) {
    int err = dht22.read2(&temperatureVal, &humidityVal, NULL);

    if (err != SimpleDHTErrSuccess) {
      Serial.println("error");
    } else {
      lastState = max_state;
    }
  }

  if (state == lastState)
    return;

  // reset screen and draw screen according to state
  display.fillScreen(ILI9341_BLACK);

  if (state == weather) {
    weatherScreen();
  } else if (state == humidity) {
    humidityScreen();
  } else if (state == clock_and_date) {
    clockScreen();
  }

  Serial.println(state);

  lastState = state;

  delay(150);
}

ICACHE_RAM_ATTR void button_isr() {
  if(millis() - lastButtonInterrupt > 250) {
    state = static_cast<displayState>(static_cast<int>(state) + 1);

    if (state == max_state)
      state = weather;

    lastButtonInterrupt = millis();
  }
}

void weatherScreen() {
  display.setCursor(0, 0);
  display.setTextColor(ILI9341_WHITE);  display.setTextSize(4);
  display.println(normalizeString(city));

  if (weatherDescription.length() <= 13)
    display.println(weatherDescription);
  else {
    display.println(getLastWord(weatherDescription));
  }

  display.print(temp);
  display.println(" C");
  display.println("");

  if (shouldWearJacket(weatherDescription, temp)) {
    display.println("You should");
    display.println("wear a jacket");
    display.println("if going out.");
  } else {
    display.println("You don't\nneed a coat.");
  }
}

void humidityScreen() {
  display.setCursor(0, 0);

  display.setTextColor(ILI9341_WHITE);  display.setTextSize(4);
  display.println("");
  display.println("Humidity:");
  if (humidityVal - 0.00 <= 0.001) {
    display.print("Loading...");
  } else {
    display.print(humidityVal);
    display.println("%");
    display.println("");
    display.setTextSize(3);
    display.println(humidityMessage(humidityVal, temp));
  }
}

void clockScreen() {
  display.setCursor(0, 0);
  display.setTextSize(5);

  display.println("");
  display.print(hour, DEC);
  display.print(":");
  if (minute < 10)
    display.print(0);
  display.println(minute, DEC);

  display.setTextSize(3);
  display.println(dayOfTheWeek + "\n" + day + " " + month + ", " + year);
}

bool shouldWearJacket(String description, float temperature) {
  if (temperature <= 20.00)
    return true;

  if (description == "shower rain" ||
      description == "rain" ||
      description == "thunderstorm" ||
      description == "snow" ||
      description == "mist")
      return true;

  return false;
}

String checkHumidity(float humidity, float lowerBound, float upperBound, bool checkLowerBound) {
  if (humidity > upperBound)
    return "Humidity level \ntoo high for \noutside \ntemperature";
  else if (checkLowerBound && humidity < lowerBound)
    return "Humidity level \ntoo low for \noutside \ntemperature";
  else
    return "Humidity level \nis ideal";
}

String humidityMessage(float humidity, float temperature) {
  if (temperature >= 10) {
    return checkHumidity(humidity, 0.0, 45.00, false);
  } else if (temperature >= -4 && temperature < 10) {
    return checkHumidity(humidity, 0.0, 40.00, false);
  } else if (temperature >= -17.5 && temperature < -4) {
    return checkHumidity(humidity, 30.00, 40.00, true);
  } else if (temperature >= -29.00 && temperature < -17.5) {
    return checkHumidity(humidity, 20.00, 30.00, true);
  } else if (temperature < -29.00) {
    return checkHumidity(humidity, 15.00, 20.00, true);
  } else
    return "Invalid temperature";
}

void getIPInfo() {
  WiFiClient client;
  HTTPClient http;

  String serverPath = "http://api.ipify.org/?format=json/";

  do {
    jsonBuffer = httpGETRequest(serverPath.c_str());
  } while (jsonBuffer == "{}");

  Serial.println(jsonBuffer);
  JSONVar myObject = JSON.parse(jsonBuffer);

  // JSON.typeof(jsonVar) can be used to get the type of the var
  if (JSON.typeof(myObject) == "undefined") {
    Serial.println("Parsing input failed!");
    return;
  }

  Serial.print("JSON object = ");
  Serial.println(myObject);

  IP = (String) myObject;
}

void getLocationInfo() {
  WiFiClient client;
  HTTPClient http;

  String serverPath = "http://ip-api.com/json/" + IP;

  do {
    jsonBuffer = httpGETRequest(serverPath.c_str());
  } while (jsonBuffer == "{}");

  Serial.println(jsonBuffer);
  JSONVar result = JSON.parse(jsonBuffer);

  // JSON.typeof(jsonVar) can be used to get the type of the var
  if (JSON.typeof(result) == "undefined") {
    Serial.println("Parsing input failed!");
    return;
  }

  Serial.print("JSON object = ");
  Serial.println(result);

  countryCode = (String) result["CountryCode"];
  city = (String) result["city"];

  Serial.println(city);
}

void getWeatherInfo() {
  WiFiClient client;
  HTTPClient http;

  String serverPath = "http://api.openweathermap.org/data/2.5/weather?q=" + city + "," + countryCode + "&units=metric" + "&APPID=" + openWeatherMapAPIKey;

  do {
    jsonBuffer = httpGETRequest(serverPath.c_str());
  } while (jsonBuffer == "{}");

  Serial.println(jsonBuffer);
  JSONVar myObject = JSON.parse(jsonBuffer);

  // JSON.typeof(jsonVar) can be used to get the type of the var
  if (JSON.typeof(myObject) == "undefined") {
    Serial.println("Parsing input failed!");
    return;
  }

  Serial.print("JSON object = ");
  Serial.println(myObject);
  temp = (double) myObject["main"]["temp"];
  weatherDescription = (String) myObject["weather"][0]["description"];
}

String httpGETRequest(const char* serverName) {
  WiFiClient client;
  HTTPClient http;

  // Your IP address with path or Domain name with URL path
  http.begin(client, serverName);

  // Send HTTP POST request
  int httpResponseCode = http.GET();

  String payload = "{}";

  if (httpResponseCode > 0) {
    Serial.print("HTTP Response code: ");
    Serial.println(httpResponseCode);
    payload = http.getString();
  }
  else {
    Serial.print("Error code: ");
    Serial.println(httpResponseCode);
  }
  // Free resources
  http.end();

  return payload;
}

void getClockInfo() {
  year = 2000 + RTC.getYear();
  month = getMonthName(RTC.getMonth(century));
  day = RTC.getDate();
  dayOfTheWeekNumeric = RTC.getDoW();
  dayOfTheWeek = getDayOfTheWeek(RTC.getDoW());
  hour = RTC.getHour(h12, hPM);
  minute = RTC.getMinute();
}

void updateClock() {
  year = MyClock.Year();
  month = getMonthName(MyClock.Month());
  if (day < MyClock.Day()) {
    day = MyClock.Day();
    dayOfTheWeekNumeric = dayOfTheWeekNumeric + 1;
    if (dayOfTheWeekNumeric == 8)
      dayOfTheWeekNumeric = 1;
    dayOfTheWeek = getDayOfTheWeek(dayOfTheWeekNumeric);
  }
  hour = MyClock.Hour();
  minute = MyClock.Minute();
}

String getMonthName(byte month) {
	switch (month) {
	case 1:
	  return "January";
	case 2:
	  return "February";
	case 3:
	  return "March";
	case 4:
	  return "April";
	case 5:
	  return "May";
	case 6:
	  return "June";
	case 7:
	  return "July";
	case 8:
	  return "August";
	case 9:
	  return "September";
	case 10:
	  return "October";
	case 11:
	  return "November";
	case 12:
	  return "December";
	default:
	  return "Invalid month";
  }
}

String getDayOfTheWeek(byte dayOfTheWeek) {
	switch (dayOfTheWeek) {
	case 1:
	  return "Monday";
	case 2:
	  return "Tuesday";
	case 3:
	  return "Wednesday";
	case 4:
	  return "Thursday";
	case 5:
	  return "Friday";
	case 6:
	  return "Saturday";
	case 7:
	  return "Sunday";
	default:
	  return "Invalid day of the week";
  }
}

String normalizeString(String input) {
  // Arrays to map Romanian diacritics to their simpler versions
  const char diacritics[] = "ĂÂÎȘȚăâîșț";
  const char replacements[] = "AAISTaaisst";

  // Initialize the output string
  String output = input;

  // Iterate over each character in the input string
  for (size_t i = 0; i < output.length(); ++i) {
      if (output[i] == 197) {
        output[i] = 's';
        for (int j = i + 1; j < output.length() - 1; j++) {
          output[j] = output[j + 1];
        }

        output[output.length() - 1] = '\0';
      }
  }

  return output;
}

String getLastWord(const String &input) {
    // Trim any trailing spaces
    String trimmedInput = input;
    trimmedInput.trim();

    // Find the position of the last space
    int lastSpaceIndex = trimmedInput.lastIndexOf(' ');

    // Extract and return the last word
    if (lastSpaceIndex == -1) {
        // No spaces found, the entire input is one word
        return trimmedInput;
    } else {
        // Return the substring after the last space
        return trimmedInput.substring(lastSpaceIndex + 1);
    }
}
